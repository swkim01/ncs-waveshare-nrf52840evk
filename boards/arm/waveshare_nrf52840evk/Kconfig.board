## boards/arm/waveshare_nrf52840evk/Kconfig.board
```kconfig
# Copyright (c) 2023 Nordic Semiconductor ASA
# SPDX-License-Identifier: Apache-2.0

config BOARD_WAVESHARE_NRF52840EVK
	bool "waveshare_nrf52840evk"
	depends on SOC_NRF52840_QIAA
```

## boards/arm/waveshare_nrf52840evk/Kconfig.defconfig
```kconfig
# Copyright (c) 2023 Nordic Semiconductor ASA
# SPDX-License-Identifier: Apache-2.0

if BOARD_WAVESHARE_NRF52840EVK

config BOARD
	default "waveshare_nrf52840evk"

config BT_CTLR
   default BT

endif
```
